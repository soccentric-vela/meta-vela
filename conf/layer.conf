## conf/layer.conf
```bitbake
BBPATH .= ":${LAYERDIR}"

BBFILES += " \
    ${LAYERDIR}/recipes-*/*/*.bb \
    ${LAYERDIR}/recipes-*/*/*.bbappend \
"

BBFILE_COLLECTIONS += "meta-vela"
BBFILE_PATTERN_meta-vela = "^${LAYERDIR}/"
BBFILE_PRIORITY_meta-vela = "10"

LAYERDEPENDS_meta-vela = "core qcom"
LAYERSERIES_COMPAT_meta-vela = "scarthgap"
```
